## zephyrproject/army-simple-fc/boards/dropla/army_simple_fc_v1_0/Kconfig.board
```kconfig
# STM32 Nucleo-64 development board with STM32G070RB MCU configuration

# Copyright (c) 2023 Marin Jurjević <marin.jurjevic@hotmail.com>
# SPDX-License-Identifier: Apache-2.0

config BOARD_ARMY_SIMPLE_FC
	bool "Army-simple-fc G070KB Board"
	depends on SOC_STM32G070XX
```

## zephyrproject/army-simple-fc/boards/dropla/army_simple_fc_v1_0/Kconfig.defconfig
```kconfig
# STM32 Nucleo-64 development board with STM32G070RB MCU

# Copyright (c) 2023 Marin Jurjević <marin.jurjevic@hotmail.com>
# SPDX-License-Identifier: Apache-2.0

if BOARD_ARMY_SIMPLE_FC

config BOARD
	default "army_simple_fc_v1_0"

endif # BOARD_ARMY_SIMPLE_FC
```

## zephyrproject/army-simple-fc/boards/dropla/army_simple_fc_v1_0/board.yml
```yaml
board:
  name: army_simple_fc_v1_0
  vendor: dropla
  socs:
    - name: stm32g070xx
```

## zephyrproject/army-simple-fc/sample.yaml
```yaml
# This file is provided so that the application can be compiled using Twister,
# the Zephyr testing tool. In this file, multiple combinations can be specified,
# so that you can easily test all of them locally or in CI.
sample:
  description: My next try restart project
  name: fxa-custom-zephyr
common:
  build_only: true
  integration_platforms:
    - custom_plank
    - numaker_pfm_m467
tests:
  app.default: {}
```

## zephyrproject/army-simple-fc/west.yml
```yaml
# Copyright (c) 2021 Nordic Semiconductor ASA
# SPDX-License-Identifier: Apache-2.0

manifest:
  self:
    west-commands: scripts/west-commands.yml

  remotes:
    - name: zephyrproject-rtos
      url-base: https://github.com/zephyrproject-rtos
    # - name: baden
    #   url-base: https://github.com/baden
    # - name: badenwork
    #   # url-base: https://github.com/badenwork
    #   url-base: git@github.com:badenwork

  projects:
    - name: zephyr
      # remote: baden
      remote: zephyrproject-rtos
      # revision: main
      revision: v3.7.0
      # revision: 52fd66b
      # import:
      #   # By using name-allowlist we can clone only the modules that are
      #   # strictly needed by the application.
      #   name-allowlist:
      #     - cmsis      # required by the ARM port
      #     # - hal_nuvoton
    # - name: hal_nuvoton
    #   remote: badenwork
    #   revision: master
    #   path: modules/hal/nuvoton
    # - name: mcuboot
    #   remote: zephyrproject-rtos
    #   revision: 6eca8bbc2bdbf16d5ebbfd89ca27aaa9b3d88400
    #   path: bootloader/mcuboot
```
